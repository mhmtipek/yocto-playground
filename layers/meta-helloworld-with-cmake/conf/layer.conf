## layers/meta-helloworld-with-cmake/conf/layer.conf
```bitbake
# We have a conf and classes directory, add to BBPATH
BBPATH .= ":${LAYERDIR}"

# We have recipes-* directories, add to BBFILES
BBFILES += "${LAYERDIR}/recipes-*/*/*.bb \
            ${LAYERDIR}/recipes-*/*/*.bbappend"

BBFILE_COLLECTIONS += "meta-helloworld-with-cmake"
BBFILE_PATTERN_meta-helloworld-with-cmake = "^${LAYERDIR}/"
BBFILE_PRIORITY_meta-helloworld-with-cmake = "6"

LAYERDEPENDS_meta-helloworld-with-cmake = "core"
LAYERSERIES_COMPAT_meta-helloworld-with-cmake = "warrior"
```
